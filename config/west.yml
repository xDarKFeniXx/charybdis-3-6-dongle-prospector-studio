## config/west.yml
```yaml
manifest:
  remotes:
    - name: zmkfirmware
      url-base: https://github.com/zmkfirmware
    - name: badjeff
      url-base: https://github.com/badjeff
    - name: carrefinho                            # <--- add this
      url-base: https://github.com/carrefinho     # <--- and this
      
  projects:
    - name: zmk
      remote: zmkfirmware
      revision: v0.3
      import: app/west.yml

    - name: zmk-pmw3610-driver
      remote: badjeff
      revision: b7e61de08f5e2848c062d771c6ac395844ea51d9

    - name: prospector-zmk-module
      remote: carrefinho
      revision: 0639aa9fd107e2e19a7c710aeab55b683eb1f757
      
  self:
    path: config
```
